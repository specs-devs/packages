/**
 * @file wifi_connect.cpp
 * @brief Simplified WiFi Connection Helper
 *
 * This file handles the "boilerplate" code required to connect an ESP32 to a WiFi network.
 * It uses FreeRTOS Event Groups to wait for a successful connection before letting the
 * main application proceed.
 */

#include "wifi_connect.h"
#include <string.h>
#include "freertos/FreeRTOS.h"
#include "freertos/event_groups.h"
#include "esp_wifi.h"
#include "esp_event.h"
#include "esp_log.h"
#include "sdkconfig.h"

static const char *TAG = "wifi_connect";

// Event Group to signal when we are connected
static EventGroupHandle_t s_wifi_event_group;

// Bits to interpret the Event Group status
constexpr int WIFI_CONNECTED_BIT = BIT0; // Set when we get an IP address
constexpr int WIFI_FAIL_BIT = BIT1;      // Set when we fail to connect after N retries

constexpr int MAXIMUM_RETRY = 5;
static int s_retry_num = 0;

/**
 * @brief WiFi Event Handler
 *
 * This function responds to events generated by the WiFi driver and the IP stack.
 *
 * @param arg User data (unused)
 * @param event_base The type of event (WIFI_EVENT or IP_EVENT)
 * @param event_id The specific ID of the event (e.g., WIFI_EVENT_STA_START)
 * @param event_data Event-specific data
 */
static void event_handler(void *arg, esp_event_base_t event_base,
                          int32_t event_id, void *event_data) {
    // 1. WiFi Station Started -> Ready to connect
    if (event_base == WIFI_EVENT && event_id == WIFI_EVENT_STA_START) {
        esp_wifi_connect();
    }
    // 2. Disconnected -> Retry or Fail
    else if (event_base == WIFI_EVENT && event_id == WIFI_EVENT_STA_DISCONNECTED) {
        if (s_retry_num < MAXIMUM_RETRY) {
            esp_wifi_connect();
            s_retry_num++;
            ESP_LOGI(TAG, "Retrying to connect to AP...");
        } else {
            // Failed too many times, signal failure
            xEventGroupSetBits(s_wifi_event_group, WIFI_FAIL_BIT);
        }
        ESP_LOGI(TAG, "Connection to AP failed");
    }
    // 3. Got IP Address -> Success!
    else if (event_base == IP_EVENT && event_id == IP_EVENT_STA_GOT_IP) {
        auto *event = static_cast<ip_event_got_ip_t *>(event_data);
        ESP_LOGI(TAG, "Got IP: " IPSTR, IP2STR(&event->ip_info.ip));
        s_retry_num = 0;
        // Signal success to the main task
        xEventGroupSetBits(s_wifi_event_group, WIFI_CONNECTED_BIT);
    }
}

void wifi_connect(void) {
    // Create the event group to track connection status
    s_wifi_event_group = xEventGroupCreate();

    // Initialize the network interface and event loop
    ESP_ERROR_CHECK(esp_netif_init());
    ESP_ERROR_CHECK(esp_event_loop_create_default());
    esp_netif_t *netif = esp_netif_create_default_wifi_sta();

    // Optional: Static IP Configuration (if enabled in menuconfig)
#ifdef CONFIG_STATIC_IP_ENABLE
    esp_netif_dhcpc_stop(netif);
    esp_netif_ip_info_t ip_info;
    ip_info.ip.addr = esp_ip4addr_aton(CONFIG_STATIC_IP_ADDR);
    ip_info.gw.addr = esp_ip4addr_aton(CONFIG_STATIC_IP_GW);
    ip_info.netmask.addr = esp_ip4addr_aton(CONFIG_STATIC_IP_NETMASK);
    esp_netif_set_ip_info(netif, &ip_info);
#endif

    // Initialize WiFi driver with default config
    wifi_init_config_t cfg = WIFI_INIT_CONFIG_DEFAULT();
    ESP_ERROR_CHECK(esp_wifi_init(&cfg));

    // Register our event handler to listen for WiFi and IP events
    esp_event_handler_instance_t instance_any_id;
    esp_event_handler_instance_t instance_got_ip;
    ESP_ERROR_CHECK(esp_event_handler_instance_register(WIFI_EVENT,
                                                        ESP_EVENT_ANY_ID,
                                                        &event_handler,
                                                        nullptr,
                                                        &instance_any_id));
    ESP_ERROR_CHECK(esp_event_handler_instance_register(IP_EVENT,
                                                        IP_EVENT_STA_GOT_IP,
                                                        &event_handler,
                                                        nullptr,
                                                        &instance_got_ip));

    // Configure the WiFi connection (SSID, Password)
    wifi_config_t wifi_config = {};
    strlcpy((char *)wifi_config.sta.ssid, CONFIG_WIFI_SSID, sizeof(wifi_config.sta.ssid));
    strlcpy((char *)wifi_config.sta.password, CONFIG_WIFI_PASSWORD, sizeof(wifi_config.sta.password));
    wifi_config.sta.threshold.authmode = WIFI_AUTH_WPA2_PSK;

    // Start WiFi
    ESP_ERROR_CHECK(esp_wifi_set_mode(WIFI_MODE_STA));
    ESP_ERROR_CHECK(esp_wifi_set_config(WIFI_IF_STA, &wifi_config));
    ESP_ERROR_CHECK(esp_wifi_start());

    ESP_LOGI(TAG, "wifi_init_sta finished. Waiting for connection...");

    // Block here until either WIFI_CONNECTED_BIT or WIFI_FAIL_BIT is set
    EventBits_t bits = xEventGroupWaitBits(s_wifi_event_group,
                                           WIFI_CONNECTED_BIT | WIFI_FAIL_BIT,
                                           pdFALSE, // Do not clear bits on exit
                                           pdFALSE, // Wait for either bit, not both
                                           portMAX_DELAY); // Wait forever

    if (bits & WIFI_CONNECTED_BIT) {
        ESP_LOGI(TAG, "Connected to AP SSID: %s", CONFIG_WIFI_SSID);
    } else if (bits & WIFI_FAIL_BIT) {
        ESP_LOGI(TAG, "Failed to connect to SSID: %s", CONFIG_WIFI_SSID);
    } else {
        ESP_LOGE(TAG, "Unexpected Event");
    }
}
